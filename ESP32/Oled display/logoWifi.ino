#include <Wire.h>
#include <WiFi.h>
#include <Adafruit_GFX.h>
#include <Adafruit_SSD1306.h>

#define SCREEN_WIDTH 128
#define SCREEN_HEIGHT 64

Adafruit_SSD1306 oled(SCREEN_WIDTH, SCREEN_HEIGHT, &Wire, -1);

// Aquí se declara el array con el nombre adecuado
const unsigned char bitmap[] PROGMEM = {
0x00, 0x00, 0x00, 0x00, 0x00, 0x00, 0x00, 0x00, 0x00, 0x00, 0x00, 0x00, 0x00, 0x00, 0x00, 0x00,
0x00, 0x00, 0x00, 0x00, 0x00, 0x00, 0x00, 0x00, 0x00, 0x00, 0x00, 0x00, 0x00, 0x00, 0x00, 0x00,
0x00, 0x00, 0x00, 0x00, 0x00, 0x00, 0x00, 0x00, 0x00, 0x00, 0x00, 0x00, 0x00, 0x00, 0x00, 0x00,
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0x00, 0x00, 0x00, 0x00, 0x00, 0x00, 0x00, 0x00, 0x00, 0x00, 0x00, 0x00, 0x00, 0x00, 0x00, 0x00
};

void setup() {
 Serial.begin(9600);

 if (!oled.begin(SSD1306_SWITCHCAPVCC, 0x3C)) {
   Serial.println(F("failed to start SSD1306 OLED"));
   while (1);
 }

 delay(2000);
 oled.clearDisplay();

 // Dibuja el bitmap en la pantalla OLED
 oled.drawBitmap(0, 0, bitmap, SCREEN_WIDTH, SCREEN_HEIGHT, WHITE);
 oled.display();
  // Iniciar la pantalla OLED
  if(!display.begin(SSD1306_SWITCHCAPVCC, 0x3C)) { // La dirección I2C típica de la pantalla OLED es 0x3C
    Serial.println(F("Fallo en la inicialización del OLED"));
    for(;;); // Si la pantalla falla, detener el programa
  }
  display.clearDisplay();
  display.setTextSize(1); // Tamaño de texto
  display.setTextColor(SSD1306_WHITE); // Color de texto
  display.setCursor(0,0);
  display.println("Conectando a WiFi...");
  display.display();

  // Conexión a la red WiFi
  WiFi.begin(ssid, password);
  while (WiFi.status() != WL_CONNECTED) {
    delay(500);
    Serial.print(".");
  }

  // Limpia y muestra la IP obtenida
  display.clearDisplay();
  display.setCursor(0, 0);
  display.println("Conectado a WiFi");
  display.print("IP: ");
  display.println(WiFi.localIP()); // Obtiene la IP
  display.display();

  // También muestra la IP en el monitor serial
  Serial.println();
  Serial.print("Dirección IP: ");
  Serial.println(WiFi.localIP());
}

void loop() {
 // Loop vacío
}
